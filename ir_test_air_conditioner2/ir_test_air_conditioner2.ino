#include <boarddefs.h>
#include <IRremote.h>
#include <IRremoteInt.h>
#include <ir_Lego_PF_BitStreamEncoder.h>

IRsend irsend;

void setup() {
  Serial.begin(9600);
  Serial.println("IR Test OK!");
}

unsigned int Off[] = {8750,4350, 550,550, 600,550, 550,1650, 600,1650, 600,550, 550,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550, 550};
unsigned int On[] = {8700,4400, 550,550, 550,550, 550,1700, 600,1650, 550,550, 550,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550, 550};
int khz = 38;

void loop() {  

  if(Serial.available()) {
    char str = (char)Serial.read();
    if( str == '0') {
      for(int i= 0; i < 5; i++){
        irsend.sendRaw(Off, sizeof(Off) / sizeof(Off[0]), khz);
        Serial.println("Turn Off");
        delay(40); 
      }
     } else if(str == '1') {
      for(int i = 0; i < 5; i++){
        irsend.sendRaw(On, sizeof(On) / sizeof(On[0]), khz);
        Serial.println("Turn On");
        delay(40);
      }
    } else {
      Serial.println("Please try again");
    }
  }
}
